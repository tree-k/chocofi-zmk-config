/*                KEY POSITIONS
  ╭─────────────────────╮ ╭─────────────────────╮
  │  00  01  02  03  04 │ │  05  06  07  08  09 │
  │  10  11  12  13  14 │ │  15  16  17  18  19 │
  │  20  21  22  23  24 │ │  25  26  27  28  29 │
  ╰───────╮  30  31  32 │ │  33  34  35 ╭───────╯
          ╰─────────────╯ ╰─────────────╯ */

#define COMBO_TAB_MS 25

#ifndef DUMMY_KEEB
#define DUMMY_KEEB 0
#endif

/ {
    combos {
        compatible = "zmk,combos";
#define CONCAT2(x, y) x ## y
#define CONCAT(x, y) CONCAT2(x, y)
#define COMBO(name, pos, k, l) CONCAT(combo_, name) { key-positions = <pos>; bindings = <k>; layers = <l>; timeout-ms = <COMBO_TAB_MS>; };

    // ── missing letters (reduced key layouts) ─────────────────────────────────
    #if ALPHA_23332 || ALPHA_13332 || DUMMY_KEEB
        COMBO(q, 1 3, &kp Q, BASE BASE_MAC UA UA_MAC)
        COMBO(z, 2 3, &kp Z, BASE BASE_MAC UA UA_MAC)
        #if ALPHA_13332 || DUMMY_KEEB
        COMBO(v, 1 2, &kp V, BASE BASE_MAC UA UA_MAC)
        COMBO(quote, 8 18, &single_to_doublequote , BASE BASE_MAC UA UA_MAC)
        #endif
    #endif

    // ── left-hand combos ──────────────────────────────────────────────────────
        COMBO(esc, 11 12, &kp ESCAPE, BASE BASE_MAC UA UA_MAC)
        COMBO(tab, 12 13, &kp TAB, BASE BASE_MAC UA UA_MAC)
        // clipboard: same keys on every OS, PC sends Ctrl, Mac sends Cmd
        COMBO(copy, 21 22, &kp LC(C), BASE UA)
        COMBO(paste, 22 23, &kp LC(V), BASE UA)
        COMBO(cut, 21 22 23, &kp LC(X), BASE UA)
        COMBO(undo, 10 11, &kp LC(Z), BASE UA)
        COMBO(redo, 13 14, &kp LC(LS(Z)), BASE UA)
        COMBO(copy_mac, 21 22, &kp LG(C), BASE_MAC UA_MAC)
        COMBO(paste_mac, 22 23, &kp LG(V), BASE_MAC UA_MAC)
        COMBO(cut_mac, 21 22 23, &kp LG(X), BASE_MAC UA_MAC)
        COMBO(undo_mac, 10 11, &kp LG(Z), BASE_MAC UA_MAC)
        COMBO(redo_mac, 13 14, &kp LG(LS(Z)), BASE_MAC UA_MAC)

    // ── right-hand combos ─────────────────────────────────────────────────────
        // parentheses
        COMBO(lpar, 16 17, &kp LPAR, BASE BASE_MAC UA UA_MAC SYM_R NUM NUM_UA)
        COMBO(rpar, 17 18, &kp RPAR, BASE BASE_MAC UA UA_MAC SYM_R NUM NUM_UA)
        // brackets
        COMBO(lbkt, 26 27, &kp LBKT, BASE BASE_MAC UA UA_MAC SYM_R NUM NUM_UA)
        COMBO(rbkt, 27 28, &kp RBKT, BASE BASE_MAC UA UA_MAC SYM_R NUM NUM_UA)
        // delete actions
        COMBO(bspc, 6 7, &kp BSPC, BASE BASE_MAC UA UA_MAC NAV NAV_MAC NUM NUM_UA)
        COMBO(del, 7 8, &kp DEL, BASE BASE_MAC UA UA_MAC NAV NAV_MAC NUM NUM_UA)
        COMBO(del_word, 6 7 8, &kp LC(BSPC), BASE UA)
        COMBO(del_word_mac, 6 7 8, &kp LA(BSPC), BASE_MAC UA_MAC)
        COMBO(del_line, 6 7 8, &del_line, NAV)
        COMBO(del_line_mac, 6 7 8, &del_line_mac, NAV_MAC)

    // ── language ──────────────────────────────────────────────────────────────
        // right Space + right Ctrl: switch the computer's language AND the UA layer
        COMBO(lang, 34 35, &lang_pc, BASE UA)
        COMBO(lang_mac, 34 35, &lang_mac, BASE_MAC UA_MAC)
        // + Enter (all three right thumbs): only flip the UA layer, if it got out of step with the computer
        COMBO(lang_fix, 33 34 35, &tog UA, BASE UA)
        COMBO(lang_fix_mac, 33 34 35, &tog UA_MAC, BASE_MAC UA_MAC)
        // Ukrainian letters without a base key ([ ] are х ї via the bracket combos M+, and ,+.)
        COMBO(ua_kh, 8 9, &kp LBKT, UA UA_MAC)        // х  (O+P = щ+з, where х sits on a full keyboard)
        COMBO(ua_ye, 18 19, &kp SQT, UA UA_MAC)       // є  (L+; = д+ж)
        COMBO(ua_ghe, 5 6, &kp RA(U), UA UA_MAC)      // ґ  (Y+U = н+г, AltGr+г)
        COMBO(ua_apos, 28 29, &kp GRAVE, UA UA_MAC)   // ʼ  (apostrophe is the ` key in UA)

    // ── lock ──────────────────────────────────────────────────────────────────
        COMBO(lock, 0 9 32 33, &tog LOCKL, BASE BASE_MAC UA UA_MAC LOCKL)
    };
};
